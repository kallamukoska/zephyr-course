## app/boards/my_board/Kconfig.my_board
```kconfig
# Copyright 2024 NXP
# SPDX-License-Identifier: Apache-2.0

config BOARD_MY_BOARD
	select SOC_MCXN947_CPU0 if BOARD_MY_BOARD_MCXN947_CPU0 || BOARD_MY_BOARD_MCXN947_CPU0_QSPI
	select SOC_MCXN947_CPU1 if BOARD_MY_BOARD_MCXN947_CPU1
	select SOC_PART_NUMBER_MCXN947VDF
```

## app/boards/my_board/board.yml
```yaml
board:
  name: my_board
  full_name: MY_BOARD
  vendor: nxp
  socs:
  - name: mcxn947
    variants:
    - name: qspi
      cpucluster: 'cpu0'
```

## app/boards/our_board/Kconfig.our_board
```kconfig
config BOARD_OUR_BOARD
	select SOC_MCXN947_CPU0 if BOARD_OUR_BOARD_MCXN947_CPU0
	select SOC_MCXN947_CPU1 if BOARD_OUR_BOARD_MCXN947_CPU1
	select SOC_PART_NUMBER_MCXN947VDF
```

## app/boards/our_board/board.yml
```yaml
board:
  name: our_board
  full_name: Our Board From Scratch
  vendor: nxp
  socs:
    - name: mcxn947
```
